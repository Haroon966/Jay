## firmware/sdkconfig.defaults
```kconfig
# Jay – ESP32 default config
CONFIG_BT_ENABLED=y
CONFIG_BT_CLASSIC_ENABLED=y
CONFIG_BT_SPP_ENABLED=y
CONFIG_BT_SSP_ENABLED=y
CONFIG_BT_ACL_CONNECTIONS=2
CONFIG_BT_MAX_ACL_CONNECTIONS=2
CONFIG_BT_ALLOCATION_FROM_SPIRAM_FIRST=n

# FreeRTOS
CONFIG_FREERTOS_UNICORE=n
CONFIG_FREERTOS_HZ=1000

# Log level (increase for debug)
CONFIG_LOG_DEFAULT_LEVEL_INFO=y
```
